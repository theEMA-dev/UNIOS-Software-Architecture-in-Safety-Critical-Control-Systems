AUTOSAR XML (schema 00051)
package /Components
  application sw component type BlindSpotComposition
    behavior BlindSpotComposition_IB: handle-termination-and-restart=NO-SUPPORT
      timing event Event_BlindSpotComposition_Step: start-on-event=BlindSpotComposition_Step, period=0.1
      runnable BlindSpotComposition_Init
      runnable BlindSpotComposition_Step
