AUTOSAR XML (schema 00051)
package /Components/SwcImplementations
  swc implementation BlindSpotComposition_Impl: programming-language=C, sw-version=1.9.1, used-code-generator=Embedded Coder 24.2 (R2024b) 21-Jun-2024, vendor-id=0, behavior=BlindSpotComposition_IB
    code-descriptors:
      code Code
        artifact-descriptors:
          short-label=BlindSpotComposition_c, category=SWSRC
          short-label=BlindSpotLogicSWC_c, category=SWSRC
          short-label=RadarSensorSWC_c, category=SWSRC
          short-label=VehicleStatusSWC_c, category=SWSRC
          short-label=WarningDisplaySWC_c, category=SWSRC
          short-label=const_params_c, category=SWSRC
          short-label=BlindSpotComposition_h, category=SWHDR
          short-label=BlindSpotComposition_private_h, category=SWHDR
          short-label=BlindSpotComposition_types_h, category=SWHDR
          short-label=BlindSpotLogicSWC_h, category=SWHDR
          short-label=BlindSpotLogicSWC_private_h, category=SWHDR
          short-label=BlindSpotLogicSWC_types_h, category=SWHDR
          short-label=RadarSensorSWC_h, category=SWHDR
          short-label=RadarSensorSWC_private_h, category=SWHDR
          short-label=RadarSensorSWC_types_h, category=SWHDR
          short-label=VehicleStatusSWC_h, category=SWHDR
          short-label=VehicleStatusSWC_private_h, category=SWHDR
          short-label=VehicleStatusSWC_types_h, category=SWHDR
          short-label=WarningDisplaySWC_h, category=SWHDR
          short-label=WarningDisplaySWC_private_h, category=SWHDR
          short-label=WarningDisplaySWC_types_h, category=SWHDR
    resource consumption RsrcCons_BlindSpotComposition
