AUTOSAR XML (schema 00051)
standard types defined: boolean, sint32
package /DataTypes
  impl type BlindSpotDetectedType: category=VALUE, base-type=boolean, compu {0=FALSE, 1=TRUE}
  impl type TurnSignalStatusType: category=VALUE, base-type=sint32, compu {0=NONE, 1=LEFT, 2=RIGHT}
  impl type BlindSpotWarningType: category=VALUE, base-type=boolean, compu {0=FALSE, 1=TRUE}
package /DataTypes/SwAddrMethods
  sw addr method CODE: section-type=CODE
  sw addr method CONST: section-type=CONST
  sw addr method VAR: section-type=VAR
package /DataTypes/Units
  unit NoUnit: factor-si-to-unit=1, offset-si-to-unit=0
