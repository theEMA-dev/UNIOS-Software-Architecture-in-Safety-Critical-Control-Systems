AUTOSAR XML (schema 00051)
package /Components/SwcImplementations
  swc implementation BlindSpotLogicSWC_Impl: programming-language=C, sw-version=1.3.1, used-code-generator=Embedded Coder 24.2 (R2024b) 21-Jun-2024, vendor-id=0, behavior=BlindSpotLogicSWC_IB
    code-descriptors:
      code Code
        artifact-descriptors:
          short-label=BlindSpotLogicSWC_c, category=SWSRC
          short-label=BlindSpotLogicSWC_h, category=SWHDR
          short-label=BlindSpotLogicSWC_private_h, category=SWHDR
          short-label=BlindSpotLogicSWC_types_h, category=SWHDR
    resource consumption RsrcCons_BlindSpotLogicSWC
