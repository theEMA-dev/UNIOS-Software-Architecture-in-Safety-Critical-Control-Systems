AUTOSAR XML (schema 00051)
package /Interfaces
  5 x sender receiver interface:
    BlindSpotInterface_Left
      data detected: category=VALUE, sw-calibration-access=READ-ONLY, type=BlindSpotDetectedType
    BlindSpotInterface_Right
      data detected: category=VALUE, sw-calibration-access=READ-ONLY, type=BlindSpotDetectedType
    TurnSignalInterface
      data turn: category=VALUE, sw-calibration-access=READ-ONLY, type=TurnSignalStatusType
    WarningInterfaceLeft
      data warning: category=VALUE, sw-calibration-access=READ-ONLY, type=BlindSpotWarningType
    WarningInterfaceRight
      data warning: category=VALUE, sw-calibration-access=READ-ONLY, type=BlindSpotWarningType
