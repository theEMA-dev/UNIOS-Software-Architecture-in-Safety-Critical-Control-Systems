AUTOSAR XML (schema 00051)
standard types defined: boolean
package /DataTypes
  impl type BlindSpotDetectedType: category=VALUE, base-type=boolean, compu {0=FALSE, 1=TRUE}
package /DataTypes/SwAddrMethods
  sw addr method CODE: section-type=CODE
  sw addr method CONST: section-type=CONST
  sw addr method VAR: section-type=VAR
package /DataTypes/Units
  unit NoUnit: factor-si-to-unit=1, offset-si-to-unit=0
