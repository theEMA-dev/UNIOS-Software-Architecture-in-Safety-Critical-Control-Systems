AUTOSAR XML (schema 00051)
package /Components/SwcImplementations
  swc implementation RadarSensorSWC_Impl: programming-language=C, sw-version=1.4.1, used-code-generator=Embedded Coder 24.2 (R2024b) 21-Jun-2024, vendor-id=0, behavior=RadarSensorSWC_IB
    code-descriptors:
      code Code
        artifact-descriptors:
          short-label=RadarSensorSWC_c, category=SWSRC
          short-label=RadarSensorSWC_data_c, category=SWSRC
          short-label=RadarSensorSWC_h, category=SWHDR
          short-label=RadarSensorSWC_private_h, category=SWHDR
          short-label=RadarSensorSWC_types_h, category=SWHDR
    resource consumption RsrcCons_RadarSensorSWC
