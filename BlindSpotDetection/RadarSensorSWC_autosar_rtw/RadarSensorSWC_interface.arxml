AUTOSAR XML (schema 00051)
package /Interfaces
  sender receiver interface BlindSpotInterface_Left
    data detected: category=VALUE, sw-calibration-access=READ-ONLY, type=BlindSpotDetectedType
  sender receiver interface BlindSpotInterface_Right
    data detected: category=VALUE, sw-calibration-access=READ-ONLY, type=BlindSpotDetectedType
