AUTOSAR XML (schema 00051)
standard types defined: sint32
package /DataTypes
  impl type TurnSignalStatusType: category=VALUE, base-type=sint32, compu {0=NONE, 1=LEFT, 2=RIGHT}
package /DataTypes/SwAddrMethods
  sw addr method CODE: section-type=CODE
  sw addr method CONST: section-type=CONST
  sw addr method VAR: section-type=VAR
package /DataTypes/Units
  unit NoUnit: factor-si-to-unit=1, offset-si-to-unit=0
