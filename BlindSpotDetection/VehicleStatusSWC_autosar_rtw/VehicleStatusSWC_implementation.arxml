AUTOSAR XML (schema 00051)
package /Components/SwcImplementations
  swc implementation VehicleStatusSWC_Impl: programming-language=C, sw-version=1.6.1, used-code-generator=Embedded Coder 24.2 (R2024b) 21-Jun-2024, vendor-id=0, behavior=VehicleStatusSWC_IB
    code-descriptors:
      code Code
        artifact-descriptors:
          short-label=VehicleStatusSWC_c, category=SWSRC
          short-label=VehicleStatusSWC_data_c, category=SWSRC
          short-label=VehicleStatusSWC_h, category=SWHDR
          short-label=VehicleStatusSWC_private_h, category=SWHDR
          short-label=VehicleStatusSWC_types_h, category=SWHDR
    resource consumption RsrcCons_VehicleStatusSWC
