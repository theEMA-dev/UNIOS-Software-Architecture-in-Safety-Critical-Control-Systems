AUTOSAR XML (schema 00051)
package /Interfaces
  sender receiver interface TurnSignalInterface
    data status: category=VALUE, sw-calibration-access=READ-ONLY, type=TurnSignalStatusType
