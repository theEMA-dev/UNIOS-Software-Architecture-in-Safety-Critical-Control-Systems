AUTOSAR XML (schema 00051)
package /Components/SwcImplementations
  swc implementation WarningDisplaySWC_Impl: programming-language=C, sw-version=1.2.1, used-code-generator=Embedded Coder 24.2 (R2024b) 21-Jun-2024, vendor-id=0, behavior=WarningDisplaySWC_IB
    code-descriptors:
      code Code
        artifact-descriptors:
          short-label=WarningDisplaySWC_c, category=SWSRC
          short-label=WarningDisplaySWC_h, category=SWHDR
          short-label=WarningDisplaySWC_private_h, category=SWHDR
          short-label=WarningDisplaySWC_types_h, category=SWHDR
    resource consumption RsrcCons_WarningDisplaySWC
