AUTOSAR XML (schema 00051)
package /Interfaces
  sender receiver interface BlindSpotWarningInterface_Left
    data detected: category=VALUE, sw-calibration-access=READ-ONLY, type=BlindSpotWarningType
  sender receiver interface BlindSpotWarningInterface_Right
    data detected: category=VALUE, sw-calibration-access=READ-ONLY, type=BlindSpotWarningType
